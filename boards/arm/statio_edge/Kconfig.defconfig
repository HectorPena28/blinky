## boards/arm/statio_edge/Kconfig.defconfig
```kconfig
# nRF52840 DK NRF52840 board configuration

# Copyright (c) 2016 Nordic Semiconductor ASA
# SPDX-License-Identifier: Apache-2.0

if statio_edge

config BOARD
	default "statio_edge"

config BT_CTLR
	default BT

endif # statio_edge
```

## build/Kconfig/Kconfig.shield
```kconfig
osource "c:/Nordic/myApps/blinky/boards/shields/*/Kconfig.shield"
osource "C:/Nordic/v2.0.0/nrf/boards/shields/*/Kconfig.shield"
```

## build/Kconfig/Kconfig.shield.defconfig
```kconfig
osource "c:/Nordic/myApps/blinky/boards/shields/*/Kconfig.defconfig"
osource "C:/Nordic/v2.0.0/nrf/boards/shields/*/Kconfig.defconfig"
```
